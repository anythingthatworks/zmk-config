## boards/shields/Scaevus/Kconfig.defconfig.txt
```kconfig
if SHIELD_SCAEVUS

# Name must be less than 16 characters long!
config ZMK_KEYBOARD_NAME
    default "scaevus"

endif
```

## boards/shields/Scaevus/Kconfig.shield.txt
```kconfig
# No whitespace after the comma or in your keyboard name!
config SHIELD_SCAEVUS
    def_bool $(shields_list_contains,scaevus)
```
